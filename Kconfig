## Kconfig
```kconfig
mainmenu "Ubuntu Rootfs Configuration"

config CPU_ARCH
	string "CPU architecture"
	default "arm64"
	help
	  Target CPU architecture (e.g. arm64, armhf).

config CPU
	string "CPU model"
	default "rk3576"
	help
	  Target CPU/SoC model.

config NAME
	string "Target name"
	default "cocolamp"
	help
	  Device or product name. Used for cache folder naming, default user, and hostname.

config PASSWORD
	string "Default password (empty means do not set password)"
	default ""
	help
	  Password applied to the default user during base stage.
	  Leave empty to skip default user password configuration.

config ROOT_PASSWORD
	string "Root password (empty means do not set root password)"
	default ""
	help
	  Password applied to root during base stage.
	  Leave empty to skip root password configuration.

source "base/Kconfig"
source "fstab/Kconfig"
source "app/Kconfig"
source "desktop/Kconfig"
source "deb/Kconfig"
source "devlop/Kconfig"
source "ros/Kconfig"
source "clean/Kconfig"
source "packge/Kconfig"
```

## app/Kconfig
```kconfig
menu "App Packages"

config UBUNTU_APP
	string "App packages"
	default "psmisc"
	help
	  Space-separated list of application packages to install.

endmenu
```

## base/Kconfig
```kconfig
menu "Base System"

config UBUNTU_BASE
	string "Ubuntu base version"
	default "26.04"
	help
	  Ubuntu version used for the base rootfs.
	  This determines the debootstrap suite and package sources.

endmenu
```

## clean/Kconfig
```kconfig
menu "Clean"

config UBUNTU_CLEAN
	bool "Clean rootfs after build"
	default y
	help
	  Clean up the rootfs after building (remove apt caches,
	  temporary files, etc.) to reduce the final image size.

if UBUNTU_CLEAN

config UBUNTU_CLEAN_APT
	bool "Clean apt caches and package lists"
	default y
	help
	  Run apt clean/autoclean and remove apt package lists/cache
	  files under /var/lib/apt/lists and /var/cache/apt.

config UBUNTU_CLEAN_DOCS
	bool "Clean documentation files"
	default n
	help
	  Remove documentation directories to reduce image size:
	  /usr/share/doc, /usr/share/man and /usr/share/info.

config UBUNTU_CLEAN_TMP
	bool "Clean temporary files"
	default y
	help
	  Remove files under /tmp and /var/tmp.

config UBUNTU_CLEAN_LOG
	bool "Clean log files"
	default y
	help
	  Remove common log files in /var/log and apt logs.

config UBUNTU_CLEAN_HISTORY
	bool "Clean shell history files"
	default y
	help
	  Remove root and user bash history files.

config UBUNTU_CLEAN_LOCALE
	bool "Clean locale data (keep C/C.UTF-8/en)"
	default n
	help
	  Remove most locale files under /usr/share/locale except
	  C, C.UTF-8 and English locales.

config UBUNTU_CLEAN_REMOVE_QEMU
	bool "Remove qemu-aarch64-static from rootfs"
	default y
	help
	  Remove /usr/bin/qemu-aarch64-static after clean stage.

config UBUNTU_CLEAN_PKG_MANAGER
	bool "Remove apt/dpkg tools and databases"
	default n
	help
	  Remove apt and dpkg binaries, libraries and databases:
	  usr/bin/apt*, usr/bin/dpkg*, usr/sbin/dpkg-*,
	  usr/lib/apt/, usr/lib/dpkg/,
	  var/lib/apt/, var/lib/dpkg/,
	  var/cache/apt/, var/cache/debconf/,
	  usr/bin/gpgv.
	  Enable only if the rootfs will never use apt/dpkg at runtime.

config UBUNTU_CLEAN_PERL
	bool "Remove Perl runtime"
	default n
	help
	  Remove the Perl binary and its base libraries
	  (usr/bin/perl, usr/lib/aarch64-linux-gnu/perl-base,
	  usr/share/perl5).
	  Enable only if no scripts or tools in the image require Perl.

config UBUNTU_CLEAN_CARGO
	bool "Remove Rust/cargo coreutils binary"
	default y
	help
	  Remove /usr/lib/cargo (contains a Rust-built coreutils binary,
	  ~11 MB). The standard coreutils binary in /usr/bin is kept.

config UBUNTU_CLEAN_SHELL_COMPLETIONS
	bool "Remove shell completion scripts"
	default n
	help
	  Remove bash/zsh/fish completion scripts (~2.4 MB):
	  usr/share/bash-completion/,
	  usr/share/zsh/,
	  usr/share/fish/.

config UBUNTU_CLEAN_PACKAGING_MISC
	bool "Remove packaging helper files"
	default n
	help
	  Remove Debian packaging helper data not needed at runtime:
	  usr/share/lintian/, usr/share/bug/,
	  usr/share/common-licenses/.

endif

endmenu
```

## deb/Kconfig
```kconfig
menu "Deb Packages"

config UBUNTU_DEB
	bool "Install custom deb packages"
	default y
	help
	  Install custom deb packages into the rootfs.

if UBUNTU_DEB

config UBUNTU_DEB_ADB
	bool "ADB"
	default y

config UBUNTU_DEB_MALI
	bool "Mali GPU (libmali-bifrost-g52)"
	default y

config UBUNTU_DEB_MPP
	bool "Rockchip MPP (Media Process Platform)"
	default y

config UBUNTU_DEB_MPP_DEV
	bool "Rockchip MPP dev"
	default n
	depends on UBUNTU_DEB_MPP

config UBUNTU_DEB_RGA
	bool "Rockchip RGA (2D Graphic Acceleration)"
	default y

config UBUNTU_DEB_RGA_DEV
	bool "Rockchip RGA dev"
	default n
	depends on UBUNTU_DEB_RGA

config UBUNTU_DEB_RKNPU2
	bool "RKNPU2 (NPU runtime)"
	default y

config UBUNTU_DEB_RKNPU2_DEV
	bool "RKNPU2 dev"
	default n
	depends on UBUNTU_DEB_RKNPU2

config UBUNTU_DEB_ROCKIT
	bool "Rockit multimedia framework"
	default y

config UBUNTU_DEB_ROCKIT_DEV
	bool "Rockit dev"
	default n
	depends on UBUNTU_DEB_ROCKIT

config UBUNTU_DEB_ROCKIT_TEST
	bool "Rockit test"
	default n
	depends on UBUNTU_DEB_ROCKIT

config UBUNTU_DEB_CAMERA
	bool "Camera Engine RKAIQ"
	default y

config UBUNTU_DEB_IVA
	bool "IVA (Intelligent Video Analytics)"
	default n

config UBUNTU_DEB_IVA_DEV
	bool "IVA dev"
	default n
	depends on UBUNTU_DEB_IVA

config UBUNTU_DEB_COMMON_ALGO
	bool "Common Algorithm RK3576"
	default n

config UBUNTU_DEB_COMMON_ALGO_DEV
	bool "Common Algorithm dev"
	default n
	depends on UBUNTU_DEB_COMMON_ALGO

config UBUNTU_DEB_GSTREAMER
	bool "GStreamer Rockchip plugin"
	default y

config UBUNTU_DEB_RECOVERY
	bool "Recovery"
	default n

config UBUNTU_DEB_WIFI_AIC8800
	bool "WiFi/BT AIC8800"
	default n

config UBUNTU_DEB_WIFI_AP6256
	bool "WiFi/BT AP6256"
	default n

config UBUNTU_DEB_WIFI_RTL8822CE
	bool "WiFi/BT RTL8822CE"
	default n

endif

endmenu
```

## desktop/Kconfig
```kconfig
menu "Desktop"

config UBUNTU_DESKTOP
	string "Desktop packages"
	default ""
	help
	  Space-separated list of desktop packages to install
	  (e.g. ubuntu-desktop-minimal).

endmenu
```

## devlop/Kconfig
```kconfig
menu "Development"

config UBUNTU_DEVLOP
	string "Development packages"
	default ""
	help
	  Space-separated list of development packages to install
	  (e.g. openssh-server cmake curl git).

config UBUNTU_DEVLOP_AUTOLOGIN
	bool "Enable GDM auto login"
	default n
	help
	  Automatically login to desktop as the default user (cocolamp).

config UBUNTU_DEVLOP_USB_ADB
	bool "Enable USB ADB"
	default y
	help
	  Enable USB ADB function in .usb_config.

config UBUNTU_DEVLOP_USB_RNDIS
	bool "Enable USB RNDIS"
	default n
	help
	  Enable USB RNDIS network function in .usb_config.

config UBUNTU_DEVLOP_USB_RNDIS_DHCP
	bool "Enable DHCP server on RNDIS"
	default y
	help
	  Start dnsmasq on RNDIS interface and assign IP addresses
	  to the connected host.

config UBUNTU_DEVLOP_USB_RNDIS_IPV4
	string "RNDIS interface IPv4/CIDR"
	default "172.16.24.1/24"
	help
	  Local IPv4 address configured on USB RNDIS interface.

config UBUNTU_DEVLOP_USB_RNDIS_DHCP_RANGE
	string "RNDIS DHCP range"
	default "172.16.24.100,172.16.24.150,12h"
	help
	  dnsmasq dhcp-range value, format: start,end,lease_time.

config UBUNTU_DEVLOP_MOUSEHOP
	bool "Install mousehop"
	default n
	help
	  Install mousehop binary to /usr/bin/.

config UBUNTU_DEVLOP_SERIAL_CONSOLE
	bool "Enable serial console login"
	default y
	help
	  Enable serial console getty service for login via serial port.

config UBUNTU_DEVLOP_SERIAL_TTY
	string "Serial console device"
	depends on UBUNTU_DEVLOP_SERIAL_CONSOLE
	default "ttyS0"
	help
	  Serial port device for console (e.g., ttyS0, ttyAMA0).

config UBUNTU_DEVLOP_SERIAL_BAUDRATE
	string "Serial console baudrate"
	depends on UBUNTU_DEVLOP_SERIAL_CONSOLE
	default "115200"
	help
	  Serial console baud rate (e.g., 115200, 57600).

endmenu
```

## fstab/Kconfig
```kconfig
menu "Fstab / Init System"

config UBUNTU_FSTAB
	string "Fstab packages"
	default "kmod systemd systemd-sysv udev"
	help
	  Space-separated list of packages to install for
	  filesystem table and init system support.

endmenu
```

## packge/Kconfig
```kconfig
menu "Package"

config UBUNTU_PACKGE
	bool "Package rootfs into image"
	default y
	help
	  Package the rootfs directory into an ext4 image file.

config UBUNTU_PACKGE_BS
	int "dd block size (bytes)"
	default 512
	depends on UBUNTU_PACKGE
	help
	  Block size for dd when creating the rootfs image.

config UBUNTU_PACKGE_COUNT
	string "dd block count"
	default "512k"
	depends on UBUNTU_PACKGE
	help
	  Number of blocks for dd (e.g. 512k = 256MB).

endmenu
```

## release/Kconfig
```kconfig
menu "Clean"

config CONFIG_UBUNTU_RELEASE
	bool "Clean rootfs after build"
	default y
	help
	  Clean up the rootfs after building (remove apt caches,
	  temporary files, etc.) to reduce the final image size.

if CONFIG_UBUNTU_RELEASE

config CONFIG_UBUNTU_RELEASE_APT
	bool "Clean apt caches and package lists"
	default y
	help
	  Run apt clean/autoclean and remove apt package lists/cache
	  files under /var/lib/apt/lists and /var/cache/apt.

config CONFIG_UBUNTU_RELEASE_RM_VIM
	bool "Remove vim and vim-runtime"
	default n
	help
	  Remove vim and vim-runtime packages (~41MB).
	  Consider installing vim-tiny as a lightweight alternative.

config CONFIG_UBUNTU_RELEASE_RM_APT
	bool "Remove apt"
	default n
	help
	  Remove apt package manager (~4.7MB).
	  WARNING: You will not be able to install/update packages on the target.

config CONFIG_UBUNTU_RELEASE_RM_PASSWD
	bool "Remove passwd"
	default n
	help
	  Remove passwd package (~4.7MB).
	  WARNING: User management commands (passwd, useradd, etc.) will be unavailable.

config CONFIG_UBUNTU_RELEASE_RM_PERL
	bool "Remove perl-base"
	default n
	help
	  Remove perl-base package (~7.9MB).
	  WARNING: Some system scripts may depend on perl.

endif

endmenu
```

## ros/Kconfig
```kconfig
menu "ROS"

config UBUNTU_ROS
	string "ROS packages"
	default ""
	help
	  Space-separated ROS apt package list to install.
	  Use full package names, for example: ros-lyrical-ros-base

endmenu
```
